## zmk-modules/tapithium-core/Kconfig
```kconfig
config ZMK_BEHAVIOR_TAPITHIUM_MODS
    bool
    default y
    depends on DT_HAS_ZMK_BEHAVIOR_TAPITHIUM_MODS_ENABLED

if ZMK_BEHAVIOR_TAPITHIUM_MODS

endif #ZMK_BEHAVIOR_TAPITHIUM_MODS

config ZMK_BEHAVIOR_POSITION_REPEAT
    bool
    default y
    depends on DT_HAS_ZMK_BEHAVIOR_POSITION_REPEAT_ENABLED

if ZMK_BEHAVIOR_POSITION_REPEAT

config ZMK_BEHAVIOR_POSITION_REPEAT_MAX_BINDINGS_HELD
    int
    help "Number of instances of the binding key that can be held, without the binding being ignored."
    default 10


endif #ZMK_BEHAVIOR_POSITION_REPEAT
```

## zmk-modules/tapithium-core/dts/bindings/behaviors/zmk,behavior-position-repeat.yaml
```yaml
# Copyright (c) 2026 WiggelMc
# SPDX-License-Identifier: MIT

description: Position Repeat

compatible: "zmk,behavior-position-repeat"

include: zero_param.yaml

properties:
  use-whitelist:
    type: boolean
  whitelist-handles:
    type: phandles
  whitelist-bindings:
    type: phandle-array
    specifier-space: binding
  transparent-handles:
    type: phandles
  transparent-bindings:
    type: phandle-array
    specifier-space: binding
```

## zmk-modules/tapithium-core/dts/bindings/behaviors/zmk,behavior-tapithium-mods.yaml
```yaml
# Copyright (c) 2026 WiggelMc
# SPDX-License-Identifier: MIT

description: Tapithium Mods

compatible: "zmk,behavior-tapithium-mods"

include: two_param.yaml

properties:
  mod-layers:
    type: array
    required: true
  cancel-after-idle-ms:
    type: int
    required: true
```
