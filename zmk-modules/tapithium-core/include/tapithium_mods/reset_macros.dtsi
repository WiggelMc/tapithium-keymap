/*
 * Copyright (c) 2026 WiggelMc
 *
 * SPDX-License-Identifier: MIT
 */

#include <dt-bindings/zmk/behaviors.h>
#include <dt-bindings/zmk/tapithium_mods.h>

/ {
    macros {
#if ZMK_BEHAVIOR_OMIT(TO_RES)
        /omit-if-no-ref/
#endif
        to_res: to_layer_reset {
            compatible = "zmk,behavior-macro-one-param";
            #binding-cells = <1>;
            bindings
                = <&tp TP_RESET>,
                  <&macro_param_1to1>,
                  <&to MACRO_PLACEHOLDER>;
        };

#if ZMK_BEHAVIOR_OMIT(TP_RES)
        /omit-if-no-ref/
#endif
        tp_res: tp_reset {
            compatible = "zmk,behavior-macro-two-param";
            #binding-cells = <2>;
            bindings
                = <&tp TP_RESET>,
                  <&macro_param_1to1 &macro_param_2to2>,
                  <&tp MACRO_PLACEHOLDER MACRO_PLACEHOLDER>;
        };
    };
};
